## meta-aesd/conf/layer.conf
```bitbake
BBPATH .= ":${LAYERDIR}"

BBFILES += "${LAYERDIR}/recipes-*/*/*.bb \
            ${LAYERDIR}/recipes-*/*/*.bbappend"

BBFILE_COLLECTIONS += "meta-aesd"
BBFILE_PATTERN_meta-aesd = "^${LAYERDIR}/recipes-"
BBFILE_PRIORITY_meta-aesd = "9"

LAYERDEPENDS_meta-aesd = "core"
LAYERSERIES_COMPAT_meta-aesd = "kirkstone"
```
